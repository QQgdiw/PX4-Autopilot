## src/drivers/actuators/hx8_uart_servo/Kconfig
```kconfig
menuconfig DRIVERS_ACTUATORS_HX8_UART_SERVO
	bool "HX8 UART servo"
	default n
	---help---
		Enable the FashionStar HX8 UART servo actuator driver.
```

## src/drivers/magnetic_sensor/Kconfig
```kconfig
menu "magnetic sensor"
    menuconfig COMMON_MAGNETIC_SENSOR
        bool "Common magnetic sensors"
        default n
        select DRIVERS_MAGNETIC_SENSOR_TMAG5273
        ---help---
            Enable default set of magnetic sensor drivers
    rsource "*/Kconfig"
endmenu #barometer
```

## src/drivers/magnetic_sensor/tmag5273/Kconfig
```kconfig
config DRIVERS_MAGNETIC_SENSOR_TMAG5273
	bool "TMAG5273"
	default n
	---help---
		Enable support for TMAG5273
```

## src/modules/hybrid_vehicle_control/Kconfig
```kconfig
menuconfig MODULES_HYBRID_VEHICLE_CONTROL
	bool "hybrid_vehicle_control"
	default n
	---help---
		Enable support for hybrid_vehicle_control

menuconfig USER_HYBRID_VEHICLE_CONTROL
	bool "hybrid_vehicle_control running as userspace module"
	default n
	depends on BOARD_PROTECTED && MODULES_HYBRID_VEHICLE_CONTROL
	---help---
		Put hybrid_vehicle_control in userspace memory
```

## src/modules/mini_vehicle_control/Kconfig
```kconfig
menuconfig MODULES_MINI_VEHICLE_CONTROL
	bool "mini_vehicle_control"
	default n
	---help---
		Enable the non-transforming mini quad-rover output arbiter.
```
